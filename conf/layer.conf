## conf/layer.conf
```bitbake
# We have a conf and classes directory, add to BBPATH
BBPATH .= ":${LAYERDIR}"

# We have a packages directory, add to BBFILES
BBFILES += "${LAYERDIR}/recipes-*/*/*.bb \
            ${LAYERDIR}/recipes-*/*/*.bbappend"

BBFILE_COLLECTIONS += "variscite-util"
BBFILE_PATTERN_variscite-util := "^${LAYERDIR}/"
BBFILE_PRIORITY_variscite-util = "9"

LAYERSERIES_COMPAT_variscite-util = " \
    dunfell \
    hardknott \
    kirkstone \
    langdale \
    mickledore \
"
```
